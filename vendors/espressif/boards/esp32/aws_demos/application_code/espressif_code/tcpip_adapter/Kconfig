## vendors/espressif/boards/esp32/aws_demos/application_code/espressif_code/tcpip_adapter/Kconfig
```kconfig
menu "TCPIP Stack and Adapter"

    choice TCPIP_STACK
        bool "TCPIP stack to use"
        default TCPIP_FREERTOS_STACK
        help
            Specify which networking stack to use

        config TCPIP_FREERTOS_STACK
        bool "FreeRTOS TCPIP stack"

        config TCPIP_LWIP
        bool "lwIP TCPIP Stack"
    endchoice

config IP_LOST_TIMER_INTERVAL
    int "IP Address lost timer interval (seconds)"
    range 0 65535
    default 120
    depends on TCPIP_LWIP
    help
        The value of 0 indicates the IP lost timer is disabled, otherwise the timer is enabled.
        
        The IP address may be lost because of some reasons, e.g. when the station disconnects
        from soft-AP, or when DHCP IP renew fails etc. If the IP lost timer is enabled, it will 
        be started everytime the IP is lost. Event SYSTEM_EVENT_STA_LOST_IP will be raised if
        the timer expires. The IP lost timer is stopped if the station get the IP again before
        the timer expires.
endmenu
```
